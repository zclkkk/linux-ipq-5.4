## Documentation/devicetree/bindings/soc/qcom/qti,tzlog.txt
```
QTI TZLOG

This binding describes tzlog used to inspect log created by TZ. This driver
also provides capability to capture SMMU and XPU faults found by TZ.

Required properties:
 - compatible: must contain one of "qti,tzlog"
				   "qti,tz64-hv-log"
				   "qti,tz64log"
					"qti,tzlog_ipq6018"
 - interrupts: must contain interrupt used by TZ when XPU or SMMU faults are
		found

Optional properties:
 - qti,tzbsp-diag-buf-size: contains the TZ diag buffer size. If not defined,
				memory of 4K will be used.
 - qti,hyp-enabled: defines whether TZ supports Hypervisor mode or not.

Example:

	qti,tzlog {
		compatible = "qti,tz64log";
		interrupts = <0 244 0>;
	};

	qti,tzlog {
		compatible = "qti,tz64-hv-log";
		interrupts = <0 244 0>;
	};

	qti,tzlog {
		compatible = "qti,tzlog";
	};

	tzlog: qti,tzlog {
		compatible = "qti,tzlog_ipq6018";
		interrupts = <GIC_SPI 244 IRQ_TYPE_EDGE_RISING>;
		qti,tzbsp-diag-buf-size = <0x3000>;
		qti,hyp-enabled;
		hyp-scm-cmd-id = <0xA>;
	};
```

## drivers/bus/mhi/clients/Kconfig
```kconfig
# SPDX-License-Identifier: GPL-2.0-only

menu "MHI clients support"
	depends on MHI_BUS

config MHI_UCI
	tristate "MHI UCI"
	depends on MHI_BUS
	help
	  MHI based userspace client interface driver is for transferring
	  data between host and device using standard file operations from
	  user space. Open, read, write, and close operations are supported
	  by this driver. Please check mhi_uci_match_table for all supported
	  channels that are exposed to userspace.

endmenu
```
