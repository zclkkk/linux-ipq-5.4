// SPDX-License-Identifier: (GPL-2.0+ OR BSD-3-Clause)
/*
 * IPQ9574 DB-AL01-C3 board device tree source
 *
 * Copyright (c) 2020-2021 The Linux Foundation. All rights reserved.
 */

/dts-v1/;

#include "ipq9574-db-al01-c1.dts"

/ {
	#address-cells = <0x2>;
	#size-cells = <0x2>;
	model = "Qualcomm Technologies, Inc. IPQ9574/DB-AL01-C3";
	compatible = "qcom,ipq9574-db-al01-c3", "qcom,ipq9574-db-al01", "qcom,ipq9574";
	interrupt-parent = <&intc>;
};
