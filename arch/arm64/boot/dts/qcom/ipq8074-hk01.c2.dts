// SPDX-License-Identifier: GPL-2.0-only
/dts-v1/;
/* Copyright (c) 2017, 2020, The Linux Foundation. All rights reserved.
 */
#include "ipq8074-hk01.dtsi"

/ {
	model = "Qualcomm Technologies, Inc. IPQ8074/AP-HK01-C2";
	compatible = "qcom,ipq8074-ap-hk01-c2", "qcom,ipq8074-hk01", "qcom,ipq8074";
};
